## buildroot/package/agx-agent/Config.in
```kconfig
config BR2_PACKAGE_AGX_AGENT
	bool "ANGI coding workspace"
	depends on BR2_aarch64
	depends on BR2_TOOLCHAIN_USES_GLIBC
	depends on BR2_USE_MMU
	depends on BR2_USE_WCHAR
	depends on BR2_TOOLCHAIN_HAS_THREADS
	depends on !BR2_STATIC_LIBS
	depends on BR2_PACKAGE_HOST_RUSTC_TARGET_ARCH_SUPPORTS
	select BR2_PACKAGE_AGX_OPENCODE
	select BR2_PACKAGE_PYTHON3
	select BR2_PACKAGE_PYTHON3_CURSES
	select BR2_PACKAGE_PYTHON3_SQLITE
	help
	  Agent Angi with OpenCode and the Python workspace runtime.

config BR2_PACKAGE_AGX_AGENT_SWARM
	bool "Herdr, work review and native OS tools"
	depends on BR2_PACKAGE_AGX_AGENT
	default y
	help
	  Include the three-role Herdr workspace, Monaco review assets and OS updater.
```

## buildroot/package/agx-gui/Config.in
```kconfig
config BR2_PACKAGE_AGX_GUI
	bool "ANGI headless desktop"
	depends on BR2_PACKAGE_HOST_RUSTC_TARGET_ARCH_SUPPORTS
	depends on BR2_USE_WCHAR
	depends on BR2_TOOLCHAIN_HAS_THREADS
	depends on !BR2_STATIC_LIBS
	select BR2_PACKAGE_HOST_RUSTC
	select BR2_PACKAGE_LIBXCRYPT
	select BR2_PACKAGE_FONTCONFIG
	select BR2_PACKAGE_DEJAVU
	help
	  ANGI desktop with a software framebuffer and loopback VNC.
```

## buildroot/package/agx-opencode/Config.in
```kconfig
config BR2_PACKAGE_AGX_OPENCODE
	bool "OpenCode ARM64 CLI for ANGI"
	depends on BR2_aarch64
	depends on BR2_USE_MMU
	depends on BR2_TOOLCHAIN_USES_GLIBC
	depends on BR2_PACKAGE_HOST_RUSTC_TARGET_ARCH_SUPPORTS
	select BR2_PACKAGE_BASH
	select BR2_PACKAGE_GIT
	select BR2_PACKAGE_RIPGREP
	select BR2_PACKAGE_CA_CERTIFICATES
	help
	  Pinned official OpenCode terminal coding agent, with Git and ripgrep.
	  User data and caches are stored privately on mounted NVMe.
```

## buildroot/package/agx-web/Config.in
```kconfig
config BR2_PACKAGE_AGX_WEB
	bool "ANGI Web application"
	depends on BR2_aarch64
	depends on BR2_INSTALL_LIBSTDCPP
	depends on BR2_USE_WCHAR
	depends on BR2_TOOLCHAIN_HAS_THREADS_NPTL
	depends on !BR2_STATIC_LIBS
	depends on BR2_PACKAGE_HAS_LIBEGL
	depends on BR2_PACKAGE_HAS_LIBGLES
	select BR2_PACKAGE_AGX_WEBKIT
	help
	  Lightweight WPEPlatform embedding host for the ANGI desktop.
	  Launched on demand by the GUI's Web app.
```

## buildroot/package/agx/Config.in
```kconfig
config BR2_PACKAGE_AGX
	bool "AGX system console"
	depends on BR2_PACKAGE_HOST_RUSTC_TARGET_ARCH_SUPPORTS
	select BR2_PACKAGE_HOST_RUSTC
	select BR2_PACKAGE_LIBXCRYPT if BR2_TOOLCHAIN_USES_GLIBC
	help
	  Rust headless system console, live TUI, and JSON status command.
```
